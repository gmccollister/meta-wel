## conf/distro/ntel.conf
```bitbake
#@--------------------------------------------------------------------
#@TYPE: Distribution
#@NAME: ntel
#@DESCRIPTION: NovaTech Embedded Linux
#@MAINTAINER: George McCollister <george.mccollister@gmail.com>
#@--------------------------------------------------------------------

DISTRO_VERSION = "v0.01"

#Images built can have to modes:
# 'debug': empty rootpassword, strace included
# 'release' no root password, no strace and gdb by default
DISTRO_TYPE ?= "debug"
#DISTRO_TYPE = "release"

# Set the toolchain type (internal, external) and brand (generic, csl etc.)
TOOLCHAIN_TYPE ?= "internal"
TOOLCHAIN_BRAND ?= ""
```

## conf/distro/wel.conf
```bitbake
#@--------------------------------------------------------------------
#@TYPE: Distribution
#@NAME: wel
#@DESCRIPTION: Weather Embedded Linux
#@MAINTAINER: George McCollister <george.mccollister@gmail.com>
#@--------------------------------------------------------------------

DISTRO_VERSION = "v0.01"

#Images built can have to modes:
# 'debug': empty rootpassword, strace included
# 'release' no root password, no strace and gdb by default
DISTRO_TYPE ?= "debug"
#DISTRO_TYPE = "release"

# Set the toolchain type (internal, external) and brand (generic, csl etc.)
TOOLCHAIN_TYPE ?= "internal"
TOOLCHAIN_BRAND ?= ""

ONLINE_PACKAGE_MANAGEMENT = "full"

PREFERRED_PROVIDER_dbus-glib	= "dbus-glib"
PREFERRED_PROVIDER-gconf-dbus	= "gconf"
PREFERRED_PROVIDER_hotplug	= "systemd"

TASK_BASIC_SSHDAEMON = "openssh-sshd openssh-sftp openssh-sftp-server"

DISTRO_FEATURES = "ext2 ipv4 largefile pam pci systemd usbhost vfat x11 opengl pam"

# Inherit the default LIBC features superset from OE-core
DISTRO_FEATURES += "${DISTRO_FEATURES_LIBC}"
```

## conf/layer.conf
```bitbake
# We have a conf and classes directory, add to BBPATH
BBPATH .= ":${LAYERDIR}"

# We have recipes-* directories, add to BBFILES
BBFILES += "${LAYERDIR}/recipes-*/*/*.bb \
            ${LAYERDIR}/recipes-*/*/*.bbappend"

BBFILE_COLLECTIONS += "wel"
BBFILE_PATTERN_wel := "^${LAYERDIR}/"
BBFILE_PRIORITY_wel = "7"
```
